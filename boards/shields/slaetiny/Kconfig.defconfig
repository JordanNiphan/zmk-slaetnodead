## boards/shields/slaetiny/Kconfig.defconfig
```kconfig
if SHIELD_SLAETINY_LEFT

config ZMK_KEYBOARD_NAME
    default "SLAETINY"

config ZMK_SPLIT_ROLE_CENTRAL
    default y

endif

if SHIELD_SLAETINY_LEFT || SHIELD_SLAETINY_RIGHT

config ZMK_SPLIT
    default y

endif
```
