#include <dt-bindings/led/led.h>

&pinctrl {
    i2c0_default: i2c0_default { // Or i2c1_default if using I2C1
        group1 {
            psels = <NRF_PSEL(TWIM_SDA, 0, 17)>, // P0.17 as SDA
                    <NRF_PSEL(TWIM_SCL, 0, 20)>; // P0.20 as SCK
        };
    };
};